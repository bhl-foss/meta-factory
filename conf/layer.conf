## conf/layer.conf
```bitbake
# We might have a conf and classes directory, append to BBPATH
BBPATH .= ":${LAYERDIR}"

# We have a recipes directory, add to BBFILES
BBFILES += "${LAYERDIR}/recipes*/*/*.bb ${LAYERDIR}/recipes*/*/*.bbappend"

BBFILE_COLLECTIONS += "factory-layer"
BBFILE_PATTERN_factory-layer := "^${LAYERDIR}/"
BBFILE_PRIORITY_factory-layer = "11"

LAYERDEPENDS_factory-layer = " \
  partner-layer \
"
LAYERSERIES_COMPAT_factory-layer = "kirkstone"

BBFILES_DYNAMIC += " \
"
```
